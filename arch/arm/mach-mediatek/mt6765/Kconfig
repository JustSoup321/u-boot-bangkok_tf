## board/mediatek/mt6765/Kconfig
```kconfig
if TARGET_MT6765

config SYS_BOARD
    default "mt6765"
    help
      Bangkok_TF, otherwise known as TCL A3 is a phone manufactured by
      TCL Technology for the North American market. It includes
      various interconnects, such as Micro-USB and 3.5mm TRS connector.
    
config SYS_VENDOR
    default "TCL"

config SYS_CONFIG_NAME
    default "mt6765"

endif
```

## configs/mt6765_defconfig
```kconfig
CONFIG_ARM=y
CONFIG_TARGET_MT6765=y
CONFIG_DEFAULT_DEVICE_TREE="mt6765-bangkok_tf"
CONFIG_SYS_MALLOC_LEN=0x400000
#CONFIG_SYS_INIT_SP_ADDR=[ T O D O ]
CONFIG_POSITION_INDEPENDENT=n
CONFIG_SYS_SDRAM_BASE=0x1022a000
CONFIG_DEBUG_UART=y
CONFIG_DEBUG_UART_SKIP_INIT=y
CONFIG_DEBUG_UART_BASE=0x11002000
CONFIG_LOGLEVEL=8
CONFIG_LINUX_KERNEL_IMAGE_HEADER=2
```
